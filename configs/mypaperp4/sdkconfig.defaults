## firmware/emulator/Kconfig.projbuild
```kconfig
menu "S31 independent emulator"
    config MYPAPER_S31_TOUCH_MIRROR_X
        bool "Mirror portrait touch X"
        default n
    config MYPAPER_S31_TOUCH_MIRROR_Y
        bool "Mirror portrait touch Y"
        default n
endmenu
```

## main/Kconfig.projbuild
```kconfig
menu "Storage Configuration"

    config STORAGE_SD_PWR_CTRL_LDO_INTERNAL_IO
        depends on SOC_SDMMC_IO_POWER_EXTERNAL
        bool "SD card power supply comes from internal LDO IO"
        default y
        help
            Enable this when the SD card IO power is supplied by the ESP32-P4
            internal LDO. Disable it if the SD card is powered externally.

    config STORAGE_SD_PWR_CTRL_LDO_IO_ID
        depends on SOC_SDMMC_IO_POWER_EXTERNAL && STORAGE_SD_PWR_CTRL_LDO_INTERNAL_IO
        int "SD card LDO ID"
        default 4 if IDF_TARGET_ESP32P4

endmenu

menu "Wi-Fi Configuration"

    config WIFI_SETTING_CONNECT_TIMEOUT_MS
        int "Wi-Fi connect timeout in milliseconds"
        default 20000

endmenu

menu "Audio Radio Configuration"

    config MYPAPER_USB_AUDIO
        bool "Enable ESP32-P4 USB Host UAC headphone output"
        depends on IDF_TARGET_ESP32P4
        default y
        help
            Enable UAC 1.0 PCM playback through the ESP32-P4 High-Speed USB
            Host port. The existing ES8311 speaker remains available.

    config MYPAPER_USB_AUDIO_SOFTWARE_VOLUME
        bool "Use software volume for USB audio"
        depends on MYPAPER_USB_AUDIO
        default y
        help
            Scale 16-bit PCM in the application and skip the optional UAC
            Feature Unit volume-range probe. Some otherwise compatible USB
            headsets advertise volume control but time out on GET_MIN/MAX/RES.

    config MYPAPER_USB_AUDIO_MAX_VOLUME
        int "USB headphone software volume ceiling (%)"
        depends on MYPAPER_USB_AUDIO_SOFTWARE_VOLUME
        range 1 100
        default 5
        help
            Limit the maximum PCM amplitude sent to USB headphones. The UI
            continues to use a 0..100 scale; UI 100 maps to this percentage of
            full-scale PCM. A value of 50 is approximately -6 dB.

    config AUDIO_RADIO_ENABLE_ON_BOOT
        bool "Start network radio on boot"
        default y

    config AUDIO_RADIO_NAME
        string "Default station name"
        default "CNR China Voice"

    config AUDIO_RADIO_URL
        string "Default station URL"
        default "http://ngcdn001.cnr.cn/live/zgzs/index.m3u8"

    config AUDIO_RADIO_OUTPUT_VOLUME
        int "Output volume"
        range 0 100
        default 30

    config AUDIO_RADIO_INPUT_GAIN_DB
        int "ES8311 input gain in dB"
        range 0 45
        default 30

    config AUDIO_RADIO_SAMPLE_RATE
        int "Codec output sample rate"
        default 48000

    config AUDIO_RADIO_I2C_PORT
        int "ES8311 I2C port"
        default 1 if IDF_TARGET_ESP32P4
        default 0

    config AUDIO_RADIO_I2C_SDA_GPIO
        int "ES8311 I2C SDA GPIO"
        default 7

    config AUDIO_RADIO_I2C_SCL_GPIO
        int "ES8311 I2C SCL GPIO"
        default 8

    config AUDIO_RADIO_I2S_MCLK_GPIO
        int "ES8311 MCLK GPIO"
        default 13

    config AUDIO_RADIO_I2S_SCLK_GPIO
        int "ES8311 SCLK/BCLK GPIO"
        default 12

    config AUDIO_RADIO_I2S_ASDOUT_GPIO
        int "ES8311 ASDOUT/DIN-to-ESP GPIO"
        default 11

    config AUDIO_RADIO_I2S_LRCK_GPIO
        int "ES8311 LRCK/WS GPIO"
        default 10

    config AUDIO_RADIO_I2S_DSDIN_GPIO
        int "ES8311 DSDIN/DOUT-from-ESP GPIO"
        default 9

    config AUDIO_RADIO_PA_CTRL_GPIO
        int "NS4150B PA_CTRL GPIO"
        default 53

endmenu

menu "USB Modem Development"

    config MYPAPER_USB_MODEM_PROBE
        bool "Enable ML307A USB descriptor and AT probe on boot"
        depends on IDF_TARGET_ESP32P4
        default y
        help
            Install the ESP32-P4 High-Speed USB Host after display startup and
            log its descriptors, claim vendor interface 2, and validate it
            with AT/ATI/SIM/signal/registration queries. RNDIS interfaces 0/1,
            auxiliary AT interface 3, and DIAG interface 4 remain unclaimed.
            Disable this option when HS is used by USB Audio or USB MSC.

endmenu
```

## main/boards/MyPaperS31/application/Kconfig.projbuild
```kconfig
# Full application settings are shared with the P4 UI. Hardware-specific
# options retain target dependencies in the shared configuration.
rsource "../../../Kconfig.projbuild"

menu "MyPaperS31 optional hardware"
    config MYPAPER_S31_CAMERA
        bool "Enable optional GC2145 camera"
        default y
        help
            Probe the GC2145 at normal system boot and show its application
            only if detected. Image buffers are allocated on opening the app.
            Disable to omit the application and capture implementation.
    config MYPAPER_S31_CELLULAR
        bool "Enable optional NT26 cellular data"
        default y
        help
            Probe NT26 with AT at normal system boot. Hide 4G/SIM options if
            absent; start the full data connection only when 4G is selected.
endmenu

menu "MyPaperS31 touch mapping"
    config MYPAPER_S31_TOUCH_ROTATION
        int "FT6336U mounting transform (0..7)"
        range 0 7
        default 1
        help
            The panel has offset_rotation=3. Transform 1 cancels it for a
            portrait touch controller reporting X=0..683, Y=0..1215.
            This changes touch mapping only, not screen orientation.
    config MYPAPER_S31_TOUCH_MIRROR_X
        bool "Mirror raw touch X axis"
        default n
    config MYPAPER_S31_TOUCH_MIRROR_Y
        bool "Mirror raw touch Y axis"
        default n
endmenu
```
